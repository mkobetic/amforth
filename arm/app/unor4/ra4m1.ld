
OUTPUT_FORMAT("elf32-littlearm")
OUTPUT_ARCH(arm)

/* https://github.com/Arduino/ArduinoCore-renesas/blob/main/variants/UNOWIFIR4/memory_regions.ld */

RAM_START = 0x20000000;
RAM_LENGTH = 0x8000;
FLASH_START = 0x00000000;
FLASH_LENGTH = 0x40000;
DATA_FLASH_START = 0x40100000;
DATA_FLASH_LENGTH = 0x2000;
FLASH_IMAGE_START = 0x4000;
VECTOR_TABLE_LENGTH = 0x100;
BSP_CFG_STACK_MAIN_BYTES = 0x400;


MEMORY
{
  FLASH (rx)      : ORIGIN = FLASH_IMAGE_START, LENGTH = FLASH_LENGTH - FLASH_IMAGE_START
  RAM (rwx)       : ORIGIN = RAM_START, LENGTH = RAM_LENGTH
  DATA_FLASH (rx) : ORIGIN = DATA_FLASH_START, LENGTH = DATA_FLASH_LENGTH
}

INCLUDE amforth32.ld